## boards/nicekeyboards/nice_nano/Kconfig
```kconfig
# Copyright (c) nice!nano community
# SPDX-License-Identifier: Apache-2.0

config BOARD_NICE_NANO_NRF52840
	select SOC_NRF52840_QIAA

# nRF52840 has an integrated BT controller — no external UART HCI needed
choice BT_HCI_BUS_TYPE
	default BT_NO_DRIVER if BT
endchoice
```

## boards/nicekeyboards/nice_nano/Kconfig.defconfig
```kconfig
# Copyright (c) nice!nano community
# SPDX-License-Identifier: Apache-2.0

if BOARD_NICE_NANO_NRF52840

config BOARD
	default "nice_nano_nrf52840"

endif # BOARD_NICE_NANO_NRF52840
```

## boards/nicekeyboards/nice_nano/nice_nano_nrf52840_defconfig
```kconfig
# SPDX-License-Identifier: Apache-2.0

# Enable MPU
CONFIG_ARM_MPU=y

# Hardware stack protection
CONFIG_HW_STACK_PROTECTION=y

# GPIO
CONFIG_GPIO=y

# USB stack (needed for DFU and CDC-ACM)
CONFIG_USB_DEVICE_STACK=y

# Low-frequency clock: this board has NO 32.768 kHz crystal, so the internal
# RC oscillator must be used. The Zephyr default for nRF52 is XTAL, and with
# that selected bt_enable() waits forever for an oscillator that never starts
# — the board hangs at boot before USB even enumerates. Bluetooth cannot work
# on this board without this.
CONFIG_CLOCK_CONTROL_NRF_K32SRC_RC=y
CONFIG_CLOCK_CONTROL_NRF_K32SRC_500PPM=y
```
